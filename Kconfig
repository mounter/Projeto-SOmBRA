## Kconfig
```kconfig
#
# Copyright (C) 2015 Gil Mendes <gil00mendes@gmail.com>
#

mainmenu "Configuração do SO"

config KERNELVERSION
    string
    option env="KERNELVERSION"

###########################
menu "Opções de Compilação"
###########################

config TOOLCHAIN_DIR
    string "Toolchain directory"
    default "/please/change/me"
    help
        Path to directory to store toolchain downloads and builds in.

config TOOLCHAIN_MAKE_JOBS
    int "Toolchain parallel build jobs"
    default 4
    help
      Argument to pass to -j for make when building the toolchain.

config EXTRA_CCFLAGS
    string "Extra CCFLAGS"
    default "-O2"
    help
      Extra compiler options for both C and C++ code.

config EXTRA_CFLAGS
    string "Extra CFLAGS"
    default ""
    help
      Extra compiler options for C code.

config EXTRA_CXXFLAGS
    string "Extra CXXFLAGS"
    default ""
    help
      Extra compiler options for C++ code.

config QEMU_BINARY
    string "QEMU binary"
    default "qemu-system-x86_64"
    help
      Path to the QEMU binary to use for the qtest build target.

config QEMU_OPTS
    string "Extra QEMU options"
    default "-serial stdio -vga std -s -localtime -m 256"
    help
      Extra options to pass to QEMU.

config EXTRA_FSIMAGE
    string "Extra filesystem image contents"
    default ""
    help
      Path to a directory containing extra files to copy in to the generated
      filesystem image.

config FORCE_VIDEO_MODE
    string "Force a video mode to be used"
    default ""
    help
      If set, the bootloader configuration file will be generated with the
      video_mode option set to this value.

#######
endmenu
#######

comment "Configurações do Target"

source "config/Kconfig.arch"
source "config/Kconfig.platform"

comment "Configurações do Sistema"

config DEBUG
    bool "Debug build"
    default y
    help
        Enable various sections of debugging code and extra checks. For the
        kernel, this enables assertions and messages with the LOG_DEBUG log
        level. It also disable the boot splash screen by default. The build
        system will generally be slower, so don't enable it unless you are
        doing kernel development or have another reason to.
```

## config/Kconfig.arch
```kconfig
#
# Copyright (C) 2015 Gil Mendes <gil00mendes@gmail.com>
#

config 32BIT
    bool

config 64BIT
    bool

config SYS_SUPPORTS_LITTLE_ENDIAN
    bool

config SYS_SUPPORTS_BIG_ENDIAN
    bool

config TOOLCHAIN_LLVM
    bool

config TOOLCHAIN_GCC
    bool

config ARCH_X86
    bool
    select SYS_SUPPORTS_LITTLE_ENDIAN
    select TOOLCHAIN_LLVM

choice
    prompt "Arquitetura"
    default ARCH_AMD64

config ARCH_AMD64
    bool "AMD64"
    select ARCH_X86
    help
        Compila para um sistema de 64-bit num processado x86.

endchoice

config ARCH
    string
    default "amd64" if ARCH_AMD64

config BOOTARCH
    string
    default "x86" if ARCH_AMD64
    default ARCH

config TOOLCHAIN_TARGET
    string
    default "x86_64-pulsar" if ARCH_AMD64

config ARCH_ASFLAGS
    string
    default ""

config ARCH_CCFLAGS
    string
    default ""

choice
    prompt "Endianness"
    default LITTLE_ENDIAN

config BIG_ENDIAN
    bool "Big endian"
    depends on SYS_SUPPORTS_BIG_ENDIAN

config LITTLE_ENDIAN
    bool "Little endian"
    depends on SYS_SUPPORTS_LITTLE_ENDIAN

endchoice
```

## config/Kconfig.platform
```kconfig
#
# Copyright (C) 2015 Gil Mendes <gil00mendes@gmail.com>
#

choice
    prompt "Plataforma"
    default PLATFORM_BIOS if ARCH_X86

config PLATFORM_EFI
    bool "EFI"
    depends on ARCH_X86
    select 64BIT
    help
        Target the EFI/UEFI PCs (MACs and new PCs).

config PLATFORM_BIOS
    bool "Standard PC"
    depends on ARCH_X86
    select 32BIT
    help
      Target the built system to x86 PCs with legacy BIOS.

endchoice

config PLATFORM
    string
    default "bios" if PLATFORM_BIOS
    default "efi" if PLATFORM_EFI
```
